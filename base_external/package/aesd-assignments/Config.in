## base_external/package/aesd-assignments/Config.in
```kconfig
config BR2_PACKAGE_AESD_ASSIGNMENTS
    bool "aesd-assignments"
    help
      Includes the writer executable, finder and tester scripts in the kernel image.
      Used to understand buildroot external trees and package builds.
```
